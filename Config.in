## Config.in
```kconfig
source "$BR2_EXTERNAL_ROCKCHIP_PATH/package/rockchip/Config.in"
source "$BR2_EXTERNAL_ROCKCHIP_PATH/package/alsa-ucm-conf/Config.in"
source "$BR2_EXTERNAL_ROCKCHIP_PATH/package/fatresize/Config.in"
source "$BR2_EXTERNAL_ROCKCHIP_PATH/package/frecon/Config.in"
source "$BR2_EXTERNAL_ROCKCHIP_PATH/package/libsrt/Config.in"
source "$BR2_EXTERNAL_ROCKCHIP_PATH/package/libtsm/Config.in"
source "$BR2_EXTERNAL_ROCKCHIP_PATH/package/lvgl/Config.in"
source "$BR2_EXTERNAL_ROCKCHIP_PATH/package/nginx-http-flv-live/Config.in"
source "$BR2_EXTERNAL_ROCKCHIP_PATH/package/nginx-rtmp/Config.in"
source "$BR2_EXTERNAL_ROCKCHIP_PATH/package/noto/Config.in"
source "$BR2_EXTERNAL_ROCKCHIP_PATH/package/python-numba/Config.in"
source "$BR2_EXTERNAL_ROCKCHIP_PATH/package/source-han-sans/Config.in"
source "$BR2_EXTERNAL_ROCKCHIP_PATH/package/uvc-gadget/Config.in"
```

## build/defconfigs/rockchip_rk3308_ramboot_defconfig
```kconfig
#include "base/base.config"
#include "base/recovery.config"
#include "chips/rk3308_arm.config"
BR2_PACKAGE_LUKSMETA=y
BR2_ROOTFS_OVERLAY+="$(BR2_EXTERNAL_ROCKCHIP_PATH)/board/rockchip/common/security-ramdisk-overlay/"
```

## package/noto/Config.in
```kconfig
# Noto Fonts

menu "Noto Fonts"
	source "$BR2_EXTERNAL_ROCKCHIP_PATH/package/noto/noto-sans-jp/Config.in"
	source "$BR2_EXTERNAL_ROCKCHIP_PATH/package/noto/noto-sans-kr/Config.in"
	source "$BR2_EXTERNAL_ROCKCHIP_PATH/package/noto/noto-sans-sc/Config.in"
	source "$BR2_EXTERNAL_ROCKCHIP_PATH/package/noto/noto-sans-tc/Config.in"
	source "$BR2_EXTERNAL_ROCKCHIP_PATH/package/noto/noto-serif-jp/Config.in"
	source "$BR2_EXTERNAL_ROCKCHIP_PATH/package/noto/noto-serif-kr/Config.in"
	source "$BR2_EXTERNAL_ROCKCHIP_PATH/package/noto/noto-serif-sc/Config.in"
	source "$BR2_EXTERNAL_ROCKCHIP_PATH/package/noto/noto-serif-tc/Config.in"
endmenu
```

## package/rockchip/ipc/Config.in
```kconfig
source "$BR2_EXTERNAL_ROCKCHIP_PATH/package/rockchip/ipc/avs/Config.in"
source "$BR2_EXTERNAL_ROCKCHIP_PATH/package/rockchip/ipc/ipcweb-backend/Config.in"
source "$BR2_EXTERNAL_ROCKCHIP_PATH/package/rockchip/ipc/iva/Config.in"
source "$BR2_EXTERNAL_ROCKCHIP_PATH/package/rockchip/ipc/minilogger/Config.in"
source "$BR2_EXTERNAL_ROCKCHIP_PATH/package/rockchip/ipc/rkfsmk/Config.in"
source "$BR2_EXTERNAL_ROCKCHIP_PATH/package/rockchip/ipc/rkipc/Config.in"
source "$BR2_EXTERNAL_ROCKCHIP_PATH/package/rockchip/ipc/samples/Config.in"
```

## package/rockchip/rkwifibt/Config.in
```kconfig
config BR2_PACKAGE_RKWIFIBT
	bool "rkwifibt"

if BR2_PACKAGE_RKWIFIBT

config BR2_PACKAGE_RKWIFIBT_STATIC
	bool "Enable static"
	depends on BR2_SHARED_STATIC_LIBS

endif
```

## package/source-han-sans/Config.in
```kconfig
# Source Han Sans Fonts

menu "Source Han Sans Fonts"
	source "$BR2_EXTERNAL_ROCKCHIP_PATH/package/source-han-sans/source-han-sans-cn/Config.in"
	source "$BR2_EXTERNAL_ROCKCHIP_PATH/package/source-han-sans/source-han-sans-hk/Config.in"
	source "$BR2_EXTERNAL_ROCKCHIP_PATH/package/source-han-sans/source-han-sans-jp/Config.in"
	source "$BR2_EXTERNAL_ROCKCHIP_PATH/package/source-han-sans/source-han-sans-kr/Config.in"
	source "$BR2_EXTERNAL_ROCKCHIP_PATH/package/source-han-sans/source-han-sans-tw/Config.in"
endmenu
```
